&i2c1 {
    status = "okay";
    pinctrl-0 = <&i2c1_scl_pb6 &i2c1_scl_pb7>; /*tente inverter as ordens e veja se dá certo*/
    pinctrl-names = "default";
	lis2dh: lis2dh@19 {
		compatible = "st,lis2dh";
		label = "LIS2DH";
		reg = <0x19>;
	};
};